AUTOSAR XML (schema 4.0)
package /Example2
  i signal Signal2: length=16
