AUTOSAR XML (schema 4.0)
package /Example1
  i signal Signal1: length=8
